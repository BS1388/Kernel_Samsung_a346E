## kernel/kernel_device_modules-6.6/drivers/samsung/pm/Kconfig
```kconfig
# drivers/samsung/Kconfig
#
# Copyright (c) 2010-2022 Samsung Electronics Co., Ltd.
#	http://www.samsung.com/
#
# Licensed under GPLv2

config SEC_PM
	tristate "Samsung PM core"
	default y
	help
	  Samsung Power Management core. Required for sec_pm_debug,
	  sec_wakeup_cpu_allocator and sec_thermistor.

config SEC_PM_DEBUG
    tristate "Enable Samsung Mobile Power management debug support"
    default n
    depends on SEC_PM
    help
      This option enables Samsung Mobile Power management debug support.
      Intended for test and debug only.

config SEC_WAKEUP_CPU_ALLOCATOR
	tristate "SEC Wakeup cpu support"
	depends on SEC_PM
	default n
	help
	  This driver supports SEC Wakeup cpu support
```
